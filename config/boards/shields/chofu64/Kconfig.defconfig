## config/boards/shields/chofu64/Kconfig.defconfig
```kconfig
if SHIELD_CHOFU64

config ZMK_KEYBOARD_NAME
    default "chofu64"

config ZMK_SLEEP
     default y

endif
```

## config/boards/shields/chofu64/Kconfig.shield
```kconfig
# No whitespace after the comma or in your keyboard name!
config SHIELD_CHOFU64
    def_bool $(shields_list_contains,chofu64)
```
